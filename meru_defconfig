## meru_defconfig
```kconfig
# Target
CONFIG_TARGET_mpc83xx=y
CONFIG_TARGET_mpc83xx_meru=y
CONFIG_TARGET_mpc83xx_meru_DEVICE_ap320=y
# Target Image
CONFIG_TARGET_ROOTFS_SQUASHFS=y
CONFIG_TARGET_ROOTFS_PARTSIZE=32

# Global build settings
CONFIG_IPK_FILES_CHECKSUMS=y
# CONFIG_PER_FEED_REPO is not set
# Kernel build options
# CONFIG_KERNEL_SWAP is not set
CONFIG_KERNEL_DEVTMPFS=y
CONFIG_KERNEL_DEVTMPFS_MOUNT=y
#CONFIG_USE_FS_ACL_ATTR=y
CONFIG_KERNEL_FS_POSIX_ACL=y
CONFIG_KERNEL_EXT4_FS_POSIX_ACL=y
CONFIG_KERNEL_JFFS2_FS_POSIX_ACL=y
CONFIG_KERNEL_TMPFS_POSIX_ACL=y

CONFIG_IMAGEOPT=y
# Version info
CONFIG_VERSIONOPT=y
CONFIG_VERSION_BUG_URL=""
CONFIG_VERSION_CODE="1"
CONFIG_VERSION_CODE_FILENAMES=y
CONFIG_VERSION_DIST="OpenWrt"
CONFIG_VERSION_FILENAMES=y
CONFIG_VERSION_HOME_URL="https://github.com/Celliwig/Meru-AP320-openwrt"
CONFIG_VERSION_HWREV=""
CONFIG_VERSION_MANUFACTURER=""
CONFIG_VERSION_MANUFACTURER_URL=""
CONFIG_VERSION_NUMBER="0"
CONFIG_VERSION_PRODUCT="AP320"
CONFIG_VERSION_REPO="http://downloads.openwrt.org/snapshots"
CONFIG_VERSION_SUPPORT_URL=""

# Kernel modules
CONFIG_PACKAGE_kmod-cfg80211=y
CONFIG_PACKAGE_kmod-mac80211=y
CONFIG_PACKAGE_kmod-ath=y
CONFIG_PACKAGE_kmod-ath9k=y
CONFIG_PACKAGE_kmod-random-core=y

# Libraries
#CONFIG_PACKAGE_libgd=n
#CONFIG_PACKAGE_libgd-full=y

# Packages
#CONFIG_PACKAGE_bandwidthd-sqlite=y
# CONFIG_PACKAGE_dnsmasq is not set
CONFIG_PACKAGE_dnsmasq-dhcpv6=y
CONFIG_PACKAGE_pciutils=y
CONFIG_PACKAGE_wireless-regdb=y
CONFIG_PACKAGE_wpad=y
CONFIG_PACKAGE_luci=y
CONFIG_PACKAGE_luci-app-acl=y
CONFIG_PACKAGE_luci-app-dcwapd=y
CONFIG_PACKAGE_luci-app-statistics=y
```
